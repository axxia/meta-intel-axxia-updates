## conf/layer.conf
```bitbake
# We have a conf and classes directory, add to BBPATH
BBPATH .= ":${LAYERDIR}"

# We have recipes-* directories, add to BBFILES
BBFILES += "${LAYERDIR}/recipes-*/*/*.bb \
	${LAYERDIR}/recipes-*/*/*.bbappend"

BBFILE_COLLECTIONS += "intel-axxia-updates"
BBFILE_PATTERN_intel-axxia-updates := "^${LAYERDIR}/"
BBFILE_PATTERN_IGNORE_EMPTY_intel-axxia-updates = "1"
BBFILE_PRIORITY_intel-axxia-updates = "6"

LAYERSERIES_COMPAT_intel-axxia-updates = "thud dunfell hardknott kirkstone"
```
